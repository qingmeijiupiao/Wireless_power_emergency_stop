## components/overrides/espnow_link/Kconfig
```kconfig
menu "ESP-NOW reliable link"
    config ESPNOW_LINK_TASK_STACK_SIZE
        int "Link task stack size in bytes"
        range 4096 32768
        default 4096
        help
            Remote button products use 5120 bytes for response/log callbacks.
endmenu
```

## main/Kconfig.projbuild
```kconfig
menu "Emergency stop controller"
    config ESTOP_OLED_SDA
        int "OLED SDA GPIO"
        range 0 21
        default 1
    config ESTOP_OLED_SCL
        int "OLED SCL GPIO"
        range 0 21
        default 2
    config ESTOP_OLED_COLUMN_OFFSET
        int "SH1106 visible column offset"
        range 0 4
        default 2
endmenu
```

## sdkconfig.defaults
```kconfig
CONFIG_ESPNOW_LINK_TASK_STACK_SIZE=5120

# CONFIG_ESP_SLEEP_GPIO_ENABLE_INTERNAL_RESISTORS is not set
```
